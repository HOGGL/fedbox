## configs/fedbox_defconfig
```kconfig
BR2_arm=y
BR2_cortex_a9=y
BR2_ARM_ENABLE_NEON=y
BR2_ARM_ENABLE_VFP=y
BR2_CCACHE=y
BR2_TOOLCHAIN_BUILDROOT_MUSL=y
BR2_PACKAGE_HOST_LINUX_HEADERS_CUSTOM_5_10=y
BR2_TARGET_GENERIC_GETTY_PORT="ttyAMA0"
BR2_SYSTEM_DHCP="eth0"
BR2_ROOTFS_USERS_TABLES="$(BR2_EXTERNAL_FEDBOX_PATH)/boards/fedbox/users_table.txt"
BR2_ROOTFS_POST_BUILD_SCRIPT="$(BR2_EXTERNAL_FEDBOX_PATH)/boards/fedbox/post_build.sh"
BR2_ROOTFS_POST_IMAGE_SCRIPT="board/qemu/post-image.sh"
BR2_ROOTFS_POST_SCRIPT_ARGS="$(BR2_DEFCONFIG)"
BR2_LINUX_KERNEL=y
BR2_LINUX_KERNEL_CUSTOM_VERSION=y
BR2_LINUX_KERNEL_CUSTOM_VERSION_VALUE="5.10.7"
BR2_LINUX_KERNEL_USE_CUSTOM_CONFIG=y
BR2_LINUX_KERNEL_CUSTOM_CONFIG_FILE="$(BR2_EXTERNAL_FEDBOX_PATH)/boards/fedbox/linux.config"
BR2_LINUX_KERNEL_DTS_SUPPORT=y
BR2_LINUX_KERNEL_INTREE_DTS_NAME="vexpress-v2p-ca9"
BR2_PACKAGE_XFSPROGS=y
BR2_PACKAGE_ERLANG=y
BR2_PACKAGE_OPENSSL=y
BR2_PACKAGE_LIBRESSL=y
BR2_PACKAGE_POSTGRESQL=y
BR2_PACKAGE_POSTGRESQL_FULL=y
BR2_TARGET_ROOTFS_EXT2=y
BR2_TARGET_ROOTFS_EXT2_SIZE="8G"
# BR2_TARGET_ROOTFS_TAR is not set
BR2_PACKAGE_HOST_QEMU=y
BR2_PACKAGE_HOST_QEMU_SYSTEM_MODE=y
BR2_PACKAGE_PLEROMA=y
```

## configs/fedbox_qemu_arm_defconfig
```kconfig
BR2_arm=y
BR2_cortex_a9=y
BR2_ARM_ENABLE_NEON=y
BR2_ARM_ENABLE_VFP=y
BR2_TOOLCHAIN_BUILDROOT_MUSL=y
BR2_PACKAGE_HOST_LINUX_HEADERS_CUSTOM_5_10=y
BR2_TARGET_GENERIC_GETTY_PORT="ttyAMA0"
BR2_SYSTEM_DHCP="eth0"
BR2_ROOTFS_OVERLAY="$(BR2_EXTERNAL_FEDBOX_PATH)/board/fedbox_common/rootfs_overlay"
BR2_ROOTFS_POST_BUILD_SCRIPT="$(BR2_EXTERNAL_FEDBOX_PATH)/board/fedbox_common/post_build.sh"
BR2_ROOTFS_POST_IMAGE_SCRIPT="board/qemu/post-image.sh"
BR2_ROOTFS_POST_SCRIPT_ARGS="$(BR2_DEFCONFIG)"
BR2_LINUX_KERNEL=y
BR2_LINUX_KERNEL_CUSTOM_VERSION=y
BR2_LINUX_KERNEL_CUSTOM_VERSION_VALUE="5.10.7"
BR2_LINUX_KERNEL_USE_CUSTOM_CONFIG=y
BR2_LINUX_KERNEL_CUSTOM_CONFIG_FILE="$(BR2_EXTERNAL_FEDBOX_PATH)/board/fedbox_qemu_arm/linux.config"
BR2_LINUX_KERNEL_DTS_SUPPORT=y
BR2_LINUX_KERNEL_INTREE_DTS_NAME="vexpress-v2p-ca9"
BR2_PACKAGE_XFSPROGS=y
BR2_PACKAGE_OPENSSL=y
BR2_PACKAGE_LIGHTTPD=y
BR2_PACKAGE_VSFTPD=y
BR2_TARGET_ROOTFS_EXT2=y
BR2_TARGET_ROOTFS_EXT2_SIZE="4G"
# BR2_TARGET_ROOTFS_TAR is not set
BR2_PACKAGE_HOST_QEMU=y
BR2_PACKAGE_HOST_QEMU_SYSTEM_MODE=y
```

## package/pleroma/Config.in
```kconfig
config BR2_PACKAGE_PLEROMA_ARCH_SUPPORTS
       bool
       default y if BR2_x86_64 || BR2_arm || BR2_aarch64

config BR2_PACKAGE_PLEROMA
	bool "pleroma (Twitter alternative)"
	depends on BR2_PACKAGE_PLEROMA_ARCH_SUPPORTS
	depends on BR2_PACKAGE_POSTGRESQL_FULL
	depends on BR2_PACKAGE_OPENSSL
	select BR2_PACKAGE_FILE
	select BR2_PACKAGE_NCURSES
	select BR2_PACKAGE_NCURSES_TARGET_PROGS
	select BR2_PACKAGE_UTIL_LINUX
	select BR2_PACKAGE_UTIL_LINUX_LIBUUID
	help
	  Free and open communication for everyone. Pleroma is social
	  networking software compatible with other Fediverse software
	  such as Mastodon, Misskey, Pixelfed and many others.

	  https://pleroma.social

comment "pleroma requires postgresql with contrib"
	depends on !BR2_PACKAGE_POSTGRESQL_FULL

comment "pleroma requires openssl"
	depends on !BR2_PACKAGE_OPENSSL
```

## package/unstoppable-domains/Config.in
```kconfig
config BR2_PACKAGE_UNSTOPPABLE_DOMAINS
	bool "unstoppable-domains"
	depends on BR2_PACKAGE_HOST_GO_TARGET_ARCH_SUPPORTS
	depends on BR2_PACKAGE_CA_CERTIFICATES
	help
	  A decentralised domain registrar based on the Ethereum
	  blockchain.

comment "unstoppable-domains requires CA certificates"
	depends on !BR2_PACKAGE_CA_CERTIFICATES
       
```
